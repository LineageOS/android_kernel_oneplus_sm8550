## drivers/input/touchscreen/oplus_touchscreen_v2/Synaptics/TD4377_noflash/Kconfig
```kconfig
#
# Synaptics td4377 touchscreen driver configuration
#
config TOUCHPANEL_SYNAPTICS_TD4377_NOFLASH
    tristate "TP td4377 IC enable or not for  OPLUS"
    help
      say Y to enable driver for Touchpanel using synaptics td4377
```

## drivers/interconnect/qcom/camsx/Kconfig
```kconfig
# SPDX-License-Identifier: GPL-2.0-only

config INTERCONNECT_QCOM_CAMSX
       tristate "Qualcomm camera-kernel/camss icc bridge driver"
       depends on INTERCONNECT_QCOM
       select INTERCONNECT_CLK
       help
         Middle man to help manage common resources shared by camss
         and camera kernel. Such resources currently include:
         CPAS, clocks and NoC.

         Select M to build this as module.
```
